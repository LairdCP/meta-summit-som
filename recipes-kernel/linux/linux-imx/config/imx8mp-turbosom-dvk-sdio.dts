// SPDX-License-Identifier: (GPL-2.0+ OR MIT)
/*
 * Copyright 2021 Laird Connectivity
 */

/dts-v1/;

#include "imx8mp-turbosom.dtsi"
#include "imx8mp-turbosom-sdio-uart.dtsi"
#include "imx8mp-turbosom-dvk.dtsi"
#include "imx8mp-turbosom-media-dvk.dtsi"
