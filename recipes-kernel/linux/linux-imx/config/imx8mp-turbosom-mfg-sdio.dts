// SPDX-License-Identifier: (GPL-2.0+ OR MIT)
/*
 * Copyright 2021 Laird Connectivity
 */

/dts-v1/;

#include "imx8mp-turbosom.dtsi"
#include "imx8mp-turbosom-sdio-uart.dtsi"
#include "imx8mp-turbosom-mfg.dtsi"
#include "imx8mp-turbosom-gpu.dtsi"
#include "imx8mp-turbosom-mipi-dvk.dtsi"
#include "imx8mp-turbosom-hdmi-dvk.dtsi"
#include "imx8mp-turbosom-lvds-bridge-dvk.dtsi"
