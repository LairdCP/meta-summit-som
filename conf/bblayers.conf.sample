## conf/bblayers.conf.sample
```bitbake
LCONF_VERSION = "7"

BBPATH = "${TOPDIR}"
BSPDIR := "${@os.path.abspath(os.path.dirname(d.getVar('FILE', True)) + '/../..')}"

BBFILES ?= ""
BBLAYERS = " \
  ${BSPDIR}/sources/meta-lrd-summitsom \
  \
  ${BSPDIR}/sources/poky/meta \
  ${BSPDIR}/sources/poky/meta-poky \
  \
  ${BSPDIR}/sources/meta-openembedded/meta-oe \
  ${BSPDIR}/sources/meta-openembedded/meta-multimedia \
  ${BSPDIR}/sources/meta-openembedded/meta-python \
  \
  ${BSPDIR}/sources/meta-freescale \
  ${BSPDIR}/sources/meta-freescale-3rdparty \
  ${BSPDIR}/sources/meta-freescale-distro \
  \
  ${BSPDIR}/sources/meta-imx/meta-bsp \
  ${BSPDIR}/sources/meta-imx/meta-sdk \
  ${BSPDIR}/sources/meta-imx/meta-ml \
  \
  ${BSPDIR}/sources/meta-openembedded/meta-networking \
  ${BSPDIR}/sources/meta-openembedded/meta-filesystems \
  \
  ${BSPDIR}/sources/meta-qt6 \
  \
  ${BSPDIR}/sources/meta-swupdate \
  ${BSPDIR}/sources/meta-timesys \
"
```

## conf/distro/imx8mp-summitsom-cmd.conf
```bitbake
require conf/distro/include/fsl-base.inc

DISTRO = "imx8mp-summitsom-cmd"
DISTRO_NAME = "Laird Connectivity Summit SOM 8M Plus"

# Remove conflicting backends
DISTRO_FEATURES = "ipv4 ipv6 systemd wifi bluetooth 3g alsa pulseaudio"
DISTRO_FEATURES_BACKFILL_CONSIDERED = "sysvinit"

VIRTUAL-RUNTIME_init_manager = "systemd"
VIRTUAL-RUNTIME_base-utils-syslog = " "
VIRTUAL-RUNTIME_base-utils-hwclock = "util-linux-hwclock"

#NO_RECOMMENDATIONS = "1"
```

## conf/distro/imx8mp-turbosom-cmd.conf
```bitbake
# FSL Distro for Wayland.

require conf/distro/include/fsl-base.inc

DISTRO = "imx8mp-turbosom-cmd"
DISTRO_NAME = "Laird Connectivity TurboSOM"

# Remove conflicting backends
DISTRO_FEATURES = "ipv4 ipv6 systemd wifi bluetooth 3g alsa pulseaudio"
DISTRO_FEATURES_BACKFILL_CONSIDERED = "sysvinit"
VIRTUAL-RUNTIME_init_manager = "systemd"

#NO_RECOMMENDATIONS = "1"
```

## conf/distro/summitsom-wayland.conf
```bitbake
require summitsom-cmd.conf

DISTRO = "summitsom-wayland"
DISTRO_NAME = "Summit SOM Wayland"

DISTRO_FEATURES += "opengl vulkan wayland pam"
```

## conf/distro/summitsom-xwayland.conf
```bitbake
require summitsom-wayland.conf

DISTRO = "summitsom-xwayland"
DISTRO_NAME = "Summit SOM XWayland"

DISTRO_FEATURES += "x11"
```

## conf/machine/imx8mp-summitsom.conf
```bitbake
#@TYPE: Machine
#@NAME: Laird Connectivity i.MX8M Plus Summit SOM
#@SOC: i.MX8
#@DESCRIPTION: Machine configuration for Laird Connectivity i.MX8M Plus Summit SOM
#@MAINTAINER: Boris Krasnovskiy <Boris.Krasnovskiy@lairdconnect.com>

require imx8mp-summitsom.inc

KERNEL_DEVICETREE = " \
    freescale/imx8mp-summitsom-dvk-pcie-uart.dtb \
    freescale/imx8mp-summitsom-dvk-sdio-uart.dtb \
    freescale/imx8mp-summitsom-dvk-sdio-uart-stop.dtb \
    freescale/imx8mp-summitsom-dvk-sdio-uart-susp.dtb \
    freescale/imx8mp-summitsom-dvk-sdio-sdio.dtb \
    freescale/imx8mp-summitsom-dvk-pcie-uart-m7-rpmsg.dtb \
    freescale/imx8mp-summitsom-dvk-sdio-uart-m7-rpmsg.dtb \
    freescale/imx8mp-summitsom-dvk-sdio-uart-stop-m7-rpmsg.dtb \
    freescale/imx8mp-summitsom-dvk-sdio-uart-susp-m7-rpmsg.dtb \
    freescale/imx8mp-summitsom-dvk-sdio-sdio-m7-rpmsg.dtb \
    freescale/imx8mp-summitsom-wbx-pcie-uart.dtb \
    freescale/imx8mp-summitsom-wbx-sdio-uart.dtb \
    freescale/imx8mp-summitsom-wbx-sdio-uart-stop.dtb \
    freescale/imx8mp-summitsom-wbx-sdio-uart-susp.dtb \
    freescale/imx8mp-summitsom-wbx-sdio-sdio.dtb \
    "

UBOOT_DTB_NAME = "imx8mp-summitsom-dvk.dtb"
UBOOT_CONFIG_BASENAME = "imx8mp_summitsom"
```

## conf/machine/imx8mp-summitsom.inc
```bitbake
#@TYPE: Machine
#@NAME: Summit SOM i.MX8M Plus
#@SOC: i.MX8
#@DESCRIPTION: Machine configuration for Summit SOM i.MX8M Plus
#@MAINTAINER: Boris Krasnovskiy <Boris.Krasnovskiy@lairdconnect.com>

MACHINEOVERRIDES =. "mx8mp:"

MACHINEOVERRIDES =. "${@bb.utils.contains('IMX_DEFAULT_BOOTLOADER', 'u-boot-imx', '', 'imx-boot-container:', d)}"

require conf/machine/include/imx-base.inc
require conf/machine/include/arm/armv8a/tune-cortexa53.inc
require summitsom.inc

DEFAULTTUNE:mx8m-nxp-bsp ?= "armv8a-crc-crypto"

MACHINE_FEATURES += "pci usbhost alsa rtc optee"

IMAGE_BOOT_FILES:remove = "${@make_dtb_boot_files(d)} ${OPTEE_BOOT_IMAGE}"

IMX_DEFAULT_BOOTLOADER = "u-boot-imx"

UBOOT_CONFIG ??= "sd"
UBOOT_CONFIG[sd] = "${UBOOT_CONFIG_BASENAME}_defconfig,sdcard"
UBOOT_CONFIG[mfgtool] = "${UBOOT_CONFIG_BASENAME}_defconfig"

# Set DDR FIRMWARE
DDR_FIRMWARE_VERSION = "202006"
DDR_FIRMWARE_NAME = " \
	lpddr4_pmu_train_1d_dmem_${DDR_FIRMWARE_VERSION}.bin \
	lpddr4_pmu_train_1d_imem_${DDR_FIRMWARE_VERSION}.bin \
	lpddr4_pmu_train_2d_dmem_${DDR_FIRMWARE_VERSION}.bin \
	lpddr4_pmu_train_2d_imem_${DDR_FIRMWARE_VERSION}.bin \
"

SPL_BINARY = "spl/u-boot-spl.bin"

ATF_PLATFORM = "imx8mp"
ATF_LOAD_ADDR = "0x970000"

IMX_EXTRA_FIRMWARE = "firmware-imx-8m"

IMXBOOT_TARGETS = \
    "${@bb.utils.contains('UBOOT_CONFIG', 'fspi', '${IMXBOOT_TARGETS_BASENAME}_flexspi', \
                                                  '${IMXBOOT_TARGETS_BASENAME}', d)}"

IMX_BOOT_SOC_TARGET = "iMX8MP"

SERIAL_CONSOLES = "115200;ttymxc1"

LOADADDR = ""
UBOOT_SUFFIX = "bin"
UBOOT_MAKE_TARGET = "all"
IMX_BOOT_SEEK = "32"

OPTEE_BIN_EXT = "8mp"
TEE_LOAD_ADDR = "0x56000000"

MACHINE_EXTRA_RDEPENDS += "${MACHINE_FIRMWARE} kernel-modules"

IMXBOOT_TARGETS_BASENAME = "flash_evk"

IMX_DEFAULT_BSP = "nxp"

MACHINE_FEATURES:remove = "nxp8987 nxp8997"
MACHINE_FIRMWARE:remove = "linux-firmware-ath10k"
MACHINE_EXTRA_RRECOMMENDS:remove = "imx-m7-demos"
```

## conf/machine/imx8mp-turbosom.conf
```bitbake
#@TYPE: Machine
#@NAME: Laird Connectivity i.MX8MP TurboSOM
#@SOC: i.MX8
#@DESCRIPTION: Machine configuration for Laird Connectivity i.MX8MP TurboSOM
#@MAINTAINER: Boris Krasnovskiy <Boris.Krasnovskiy@lairdconnect.com>

MACHINEOVERRIDES =. "mx8:mx8m:mx8mp:turbosom"

require conf/machine/include/imx-base.inc
require conf/machine/include/tune-cortexa53.inc

MACHINE_FEATURES += "pci usbhost alsa"
MACHINE_FEATURES_remove = "nxp8987"

KERNEL_DEVICETREE = " \
    freescale/imx8mp-turbosom-dvk-pcie.dtb \
    freescale/imx8mp-turbosom-dvk-sdio.dtb \
    freescale/imx8mp-turbosom-mfg-pcie.dtb \
    freescale/imx8mp-turbosom-mfg-sdio.dtb \
    "

#WKS_FILE_DEPENDS_append = " imx-m7-demos"
#IMAGE_BOOT_FILES += "imx8mp_m7_TCM_hello_world.bin \
#                    imx8mp_m7_TCM_rpmsg_lite_pingpong_rtos_linux_remote.bin \
#                    imx8mp_m7_TCM_rpmsg_lite_str_echo_rtos.bin \
#                    imx8mp_m7_TCM_sai_low_power_audio.bin \
#"

UBOOT_CONFIG ??= "sd"
UBOOT_CONFIG[sd] = "imx8mp_turbosom_defconfig,sdcard"
UBOOT_CONFIG[fspi] = "imx8mp_turbosom_defconfig"
UBOOT_CONFIG[mfgtool] = "imx8mp_turbosom_config"
SPL_BINARY = "spl/u-boot-spl.bin"

# Set DDR FIRMWARE
DDR_FIRMWARE_NAME = "lpddr4_pmu_train_1d_dmem_202006.bin lpddr4_pmu_train_1d_imem_202006.bin lpddr4_pmu_train_2d_dmem_202006.bin lpddr4_pmu_train_2d_imem_202006.bin"

MACHINE_FIRMWARE_remove = "linux-firmware-ath10k"

MACHINE_EXTRA_RDEPENDS += "${MACHINE_FIRMWARE} kernel-modules"

# Set u-boot DTB
UBOOT_DTB_NAME = "imx8mp-turbosom-dvk.dtb"

# Set imx-mkimage boot target
IMXBOOT_TARGETS = "${@bb.utils.contains('UBOOT_CONFIG', 'fspi', 'flash_evk_flexspi', 'flash_evk', d)}"

# Set Serial console
SERIAL_CONSOLES = "115200;ttymxc1"

IMAGE_BOOTLOADER = "imx-boot"

LOADADDR = ""
UBOOT_SUFFIX = "bin"
UBOOT_MAKE_TARGET = ""
IMX_BOOT_SEEK = "32"

OPTEE_BIN_EXT = "8mp"
```

## conf/machine/summitsom.inc
```bitbake
MACHINEOVERRIDES =. "summitsom:"

KERNEL_CLASSES  = "kernel-fitimage"
KERNEL_IMAGETYPES = "fitImage"

KERNEL_IMAGETYPE:summitsom = "fitImage"
IMAGE_CLASSES += "squashfs-zstd dm-verity"

UBOOT_DTB_LOADADDRESS = "0x43000000"
UBOOT_ENTRYPOINT:mx8m-generic-bsp   = "0x40400000"

PREFERRED_RPROVIDER_wireless-regdb-static = "som8mp-radio-firmware"
PREFERRED_RPROVIDER_wpa-supplicant = "summit-supplicant-som"
PREFERRED_RPROVIDER_wpa-supplicant-cli = "summit-supplicant-som"
PREFERRED_RPROVIDER_wpa-supplicant-passphrase = "summit-supplicant-som"
PREFERRED_RPROVIDER_networkmanager = "summit-networkmanager-som"
PREFERRED_RPROVIDER_networkmanager = "summit-networkmanager-som-nmcli"

FIT_KERNEL_COMP_ALG = "zstd"
FIT_KERNEL_COMP_ALG_EXTENSION = ".zstd"

UBOOT_SIGN_ENABLE = "1"
UBOOT_SIGN_KEYNAME = "dev"
FIT_PAD_ALG = "pss"

UBOOT_SIGN_IMG_KEYNAME = "dev1"
FIT_SIGN_INDIVIDUAL = "1"

#UBOOT_ENCRYPT_ENABLE = "1"
UBOOT_ENCRYPT_KEYNAME = "key"
UBOOT_ENCRYPT_IVAME = "key-iv"
FIT_ENCRYPT_ALGO = "aes128"
```

## recipes-bsp/u-boot-imx/files/git/board/laird/imx8mp_summitsom/Kconfig
```kconfig
if TARGET_IMX8MP_SUMMITSOM

config SYS_BOARD
	default "imx8mp_summitsom"

config SYS_VENDOR
	default "laird"

config SYS_CONFIG_NAME
	default "imx8mp_summitsom"

config IMX_CONFIG
	default "board/freescale/imx8mp_evk/imximage-8mp-lpddr4.cfg"

source "board/freescale/common/Kconfig"

endif
```

## recipes-bsp/u-boot-imx/files/imx8mp-summitsom/git/board/laird/imx8mp_summitsom/Kconfig
```kconfig
if TARGET_IMX8MP_SUMMITSOM

config SYS_BOARD
	default "imx8mp_summitsom"

config SYS_VENDOR
	default "laird"

config SYS_CONFIG_NAME
	default "imx8mp_summitsom"

source "board/freescale/common/Kconfig"

endif
```

## recipes-bsp/u-boot-imx/files/imx8mp-summitsom/git/board/summit/imx8mp_summitsom/Kconfig
```kconfig
if TARGET_IMX8MP_SUMMITSOM

config SYS_BOARD
	default "imx8mp_summitsom"

config SYS_VENDOR
	default "summit"

config SYS_CONFIG_NAME
	default "imx8mp_summitsom"

config SUMMIT_SECURE
	bool "Secure image" 

source "board/freescale/common/Kconfig"

endif
```

## recipes-kernel/u-boot-imx/files/git/board/laird/imx8mp_turbosom/Kconfig
```kconfig
if TARGET_IMX8MP_TURBOSOM

config SYS_BOARD
	default "imx8mp_turbosom"

config SYS_VENDOR
	default "laird"

config SYS_CONFIG_NAME
	default "imx8mp_turbosom"

source "board/freescale/common/Kconfig"

endif
```
