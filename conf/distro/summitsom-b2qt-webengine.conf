## conf/distro/summitsom-b2qt-webengine.conf
```bitbake
require summitsom-wayland.conf
include conf/distro/b2qt.conf

DISTRO = "summitsom-b2qt-webengine"
DISTRO_NAME = "Summit SOM b2qt WebEngine"

DISTROOVERRIDES .= ":summit-b2qt"

DISTRO_FEATURES:remove = "virtualization"

DEPLOY_CONF_NAME:am62xx = "Carbon AM62"
DEPLOY_CONF_NAME:j722s = "Carbon AM67"

QBSP_IMAGE_CONTENT += "\
    ${IMAGE_BASENAME}-${MACHINE}.wic.bz2 \
    ${IMAGE_BASENAME}-${MACHINE}.conf \
    ${IMAGE_BASENAME}-${MACHINE}.info \
    "

DISTRO_FEATURES:remove = "ld-is-gold"

PREFERRED_PROVIDER_virtual/egl_am62xx = "ti-img-rogue-umlibs"
PREFERRED_PROVIDER_virtual/libgles1_am62xx = "ti-img-rogue-umlibs"
PREFERRED_PROVIDER_virtual/libgles2_am62xx = "ti-img-rogue-umlibs"
PREFERRED_PROVIDER_virtual/libgbm_am62xx = "ti-img-rogue-umlibs"
PREFERRED_PROVIDER_virtual/egl_j722s = "ti-img-rogue-umlibs"
PREFERRED_PROVIDER_virtual/libgles1_j722s = "ti-img-rogue-umlibs"
PREFERRED_PROVIDER_virtual/libgles2_j722s = "ti-img-rogue-umlibs"
PREFERRED_PROVIDER_virtual/libgbm_j722s = "ti-img-rogue-umlibs"

BBMASK += "\
    meta-boot2qt/meta-boot2qt-distro/recipes-containers/containerd/containerd-opencontainers_%.bbappend \
    meta-boot2qt/meta-boot2qt-distro/recipes-containers/docker/docker-moby_%.bbappend \
    meta-boot2qt/meta-boot2qt-distro/recipes-devtools/mingw-w64/nativesdk-mingw-w64-headers_%.bbappend \
    meta-boot2qt/meta-boot2qt-distro/recipes-devtools/mingw-w64/nativesdk-mingw-w64-runtime_%.bbappend \
    meta-boot2qt/meta-boot2qt-distro/recipes-core/systemd/systemd_%.bbappend \
    "
```

## conf/distro/summitsom-b2qt.conf
```bitbake
require summitsom-b2qt-webengine.conf

DISTRO = "summitsom-b2qt"
DISTRO_NAME = "Summit SOM b2qt"

DISTRO_FEATURES:remove = "webengine"
```

## conf/distro/summitsom-cmd.conf
```bitbake
require conf/distro/poky.conf

INIT_MANAGER = "systemd"

DISTRO = "summitsom-cmd"
DISTRO_NAME = "Summit SOM Command Line"

DISTRO_FEATURES_DEFAULTS = "multilib"

DISTRO_FEATURES = "\
    usrmerge \
    largefile \
    xattr \
    ipv4 \
    ipv6 \
    systemd \
    alsa \
    usbhost \
    usbgadget \
    ${@bb.utils.contains('BBFILE_COLLECTIONS', 'summit-radio', 'wifi bluetooth', '', d)} \
    "

VIRTUAL-RUNTIME_syslog = ""
VIRTUAL-RUNTIME_base-utils-syslog = ""
VIRTUAL-RUNTIME_base-utils-hwclock = "util-linux-hwclock"

NO_RECOMMENDATIONS = "1"

GLIBC_GENERATE_LOCALES ?= "en_US.UTF-8"
IMAGE_LINGUAS ?= "en-us"

PACKAGE_CLASSES:summitsom ?= "package_ipk"

PACKAGECONFIG:remove:pn-modemmanager = "vala"

FILESYSTEM_PERMS_TABLES:remove = "files/fs-perms-volatile-log.txt"
```

## conf/distro/summitsom-rescue-initramfs.conf
```bitbake
require summitsom-rescue.conf

DISTRO = "summitsom-rescue-initramfs"
DISTRO_NAME = "Summit SOM Rescue Initramfs"

INITRAMFS_IMAGE = "image-summitsom-rescue-initramfs"
```

## conf/distro/summitsom-secure.inc
```bitbake
DISTRO .= "-secure"
DISTRO_NAME .= " Secure"

DISTROOVERRIDES .= ":summit-secure"

FILESYSTEM_PERMS_TABLES:remove = "files/fs-perms-volatile-log.txt"
```

## conf/distro/summitsom-wbx3-initramfs.conf
```bitbake
require summitsom-wbx3.conf

DISTRO = "summitsom-wbx3-initramfs"
DISTRO_NAME = "Summit SOM WBx3 Initramfs"
```

## conf/distro/summitsom-wbx3.conf
```bitbake
require conf/distro/poky.conf

DISTRO = "summitsom-wbx3"
DISTRO_NAME = "Summit SOM SD card WBx3"

INIT_MANAGER = "sysvinit"

DISTRO_FEATURES_DEFAULTS = ""

DISTRO_FEATURES = "\
    usrmerge \
    largefile \
    xattr \
    ipv4 \
    ipv6 \
    usbgadget \
    "

VIRTUAL-RUNTIME_init_manager = "busybox"

NO_RECOMMENDATIONS = "1"

GLIBC_GENERATE_LOCALES ?= " "
IMAGE_LINGUAS ?= " "

PACKAGE_CLASSES:summitsom ?= "package_ipk"

PACKAGECONFIG:remove:pn-modemmanager = "vala"
```

## conf/layer.conf
```bitbake
# We have a conf and classes directory, add to BBPATH
BBPATH =. "${LAYERDIR}:"

# We have recipes-* directories, add to BBFILES
BBFILES += " \
    ${LAYERDIR}/recipes-*/*/*.bb \
	${LAYERDIR}/recipes-*/*/*.bbappend \
    "

RFPROS_FILESHARE_AUTH ?= ""

BBFILE_COLLECTIONS += "summit-som"
BBFILE_PATTERN_summit-som = "^${LAYERDIR}/"
BBFILE_PRIORITY_summit-som = "9"

LAYERSERIES_COMPAT_summit-som = "walnascar"

SUMMIT_SOM_KEYS_DIR = "${LAYERDIR}/keys"

BBFILES_DYNAMIC += " \
    fsl-bsp-release:${LAYERDIR}/dynamic-layers/imx-bsp/recipes-*/*/*.bb \
    fsl-bsp-release:${LAYERDIR}/dynamic-layers/imx-bsp/recipes-*/*/*.bbappend \
    meta-ti-bsp:${LAYERDIR}/dynamic-layers/ti-bsp/recipes-*/*/*.bb \
    meta-ti-bsp:${LAYERDIR}/dynamic-layers/ti-bsp/recipes-*/*/*.bbappend \
    meta-summit-radio:${LAYERDIR}/dynamic-layers/summit-radio/recipes-*/*/*.bb \
    meta-summit-radio:${LAYERDIR}/dynamic-layers/summit-radio/recipes-*/*/*.bbappend \
    "

BBMASK += " \
    meta-imx-bsp/recipes-security/parsec-service \
    meta-imx-bsp/recipes-devtools/clang \
    meta-imx-bsp/recipes-core/systemd/systemd_%.bbappend \
    meta-imx-bsp/recipes-core/psplash \
    meta-imx-sdk/recipes-core/systemd \
    "

ERROR_QA:remove:summit-som = "patch-status"
```

## conf/machine/am62xx-carbon.conf
```bitbake
#@TYPE: Machine
#@NAME: AM62XX CARBON
#@DESCRIPTION: Machine configuration for the AM62XX CARBON

require conf/machine/include/am62xx-carbon.inc

KERNEL_DEVICETREE = " \
    ti/k3-am625-carbon-dvk.dtb \
    ti/k3-am625-carbon-csi2-imx219.dtbo \
    ti/k3-am625-carbon-csi2-ov5640.dtbo \
    ti/k3-am625-carbon-rgb-hdmi-adapter.dtbo \
    ti/k3-am625-carbon-rgb-lvds-7-adapter.dtbo \
    ti/k3-am625-carbon-rgb-lvds-10-adapter.dtbo \
    ti/k3-am625-carbon-lvds-d-hdmi-adapter.dtbo \
    ti/k3-am625-carbon-lvds-e-hdmi-adapter.dtbo \
    ti/k3-am625-carbon-wifi-60-sdio-sdio.dtbo \
    ti/k3-am625-carbon-wifi-60-sdio-uart.dtbo \
    ti/k3-am625-carbon-wifi-60-sdio-uart-stop.dtbo \
    ti/k3-am625-carbon-wifi-lwb-if.dtbo \
    ti/k3-am625-carbon-wifi-nx6xx.dtbo \
    ti/k3-am625-carbon-wifi-ti3xx.dtbo \
    ti/k3-am625-carbon-m2-60.dtbo \
    ti/k3-am625-carbon-m2-lwb-if.dtbo \
    ti/k3-am625-carbon-m2-nx6xx.dtbo \
    ti/k3-am625-carbon-m2-ti3xx.dtbo \
"

FIT_CONF_DEFAULT_DTB = "k3-am625-carbon-dvk.dtb"

UBOOT_MACHINE = "carbon_am62_a53_defconfig"
```

## conf/machine/imx8mm-nitrogen-smarc.conf
```bitbake
#@TYPE: Machine
#@NAME: Nitrogen SMARC i.MX8M Mini
#@SOC: i.MX8
#@DESCRIPTION: Machine configuration for Nitrogen SMARC i.MX8M Mini
#@MAINTAINER: Boris Krasnovskiy <Boris.Krasnovskiy@ezurio.com>

require conf/machine/include/imx8mm-nitrogen.inc

KERNEL_DEVICETREE_BASENAME = "nitrogen-imx8mm-smarc"

KERNEL_DEVICETREE = " \
    freescale/nitrogen-imx8mm-smarc-dvk.dtb \
    freescale/nitrogen-imx8mm-smarc-csi1-ov5640.dtbo \
    freescale/nitrogen-imx8mm-smarc-csi1-ov5645.dtbo \
    freescale/nitrogen-imx8mm-smarc-csi1-pivariety.dtbo \
    freescale/nitrogen-imx8mm-smarc-dsi0-10.dtbo \
    freescale/nitrogen-imx8mm-smarc-dsi0-7.dtbo \
    freescale/nitrogen-imx8mm-smarc-lvds0-10.dtbo \
    freescale/nitrogen-imx8mm-smarc-lvds0-7.dtbo \
    freescale/nitrogen-imx8mm-smarc-m2-60-sdio-sdio.dtbo \
    freescale/nitrogen-imx8mm-smarc-m2-60-sdio-uart.dtbo \
    freescale/nitrogen-imx8mm-smarc-m2-ifx-sdio.dtbo \
    freescale/nitrogen-imx8mm-smarc-m2-nx6xx-sdio.dtbo \
    freescale/nitrogen-imx8mm-smarc-m2-pcie.dtbo \
    freescale/nitrogen-imx8mm-smarc-m2-ti3xx-sdio.dtbo \
    freescale/nitrogen-imx8mm-smarc-mcu.dtbo \
    freescale/nitrogen-imx8mm-smarc-wifi-ifx.dtbo \
    freescale/nitrogen-imx8mm-smarc-wifi-nx6xx.dtbo \
    freescale/nitrogen-imx8mm-smarc-wifi-ti3xx.dtbo \
   "

FIT_CONF_DEFAULT_DTB = "nitrogen-imx8mm-smarc-dvk.dtb"

UBOOT_MACHINE = "nitrogen_imx8mm_defconfig"
```

## conf/machine/include/am62-carbon.inc
```bitbake
require conf/machine/include/k3.inc
require conf/machine/include/mc_k3r5.inc
require conf/machine/include/carbon-summitsom.inc

SOC_FAMILY:append = ":am62xx"

MACHINE_FEATURES += "screen gpu rtc"

require conf/machine/include/mesa-pvr.inc
PREFERRED_PROVIDER_virtual/gpudriver ?= "${BSP_ROGUE_DRIVER_PROVIDER}"

TFA_BOARD = "lite"
TFA_K3_SYSTEM_SUSPEND = "1"

OPTEEMACHINE = "k3-am62x"

SERIAL_CONSOLES = "115200;ttyS2"
```

## conf/machine/include/am6xx-carbon.inc
```bitbake
#@TYPE: Machine
#@NAME: Carbon AM6xx
#@SOC: AM62x, AM62Lx, AM67x
#@DESCRIPTION: Machine configuration for Carbon AM6xx
#@MAINTAINER: Boris Krasnovskiy <Boris.Krasnovskiy@ezurio.com>

MACHINEOVERRIDES =. "summitsom:"

# for better sstate cache reuse
DEFAULTTUNE:k3 = "armv8a-crc-crypto"

require conf/machine/include/u-boot-summit.inc
include ${@bb.utils.contains('BBFILE_COLLECTIONS', 'summit-radio', 'conf/machine/include/radio-stack.inc', '', d)}

MACHINE_FEATURES:k3r5 = ""
MACHINE_FEATURES:k3 = "usbgadget usbhost alsa rtc optee screen wifi bluetooth camera"

TI_PREFERRED_BSP = "ti-6_18"

SWUPDATE_IMAGES = "${SPL_BINARYNAME} u-boot.${UBOOT_SUFFIX} tiboot3.bin uboot.env fitImage"

BSP_BOOTLOADER_PROVIDER:bsp-ti-6_18 = "u-boot-ti-summit"
BSP_BOOTLOADER_VERSION:bsp-ti-6_18 = "%"

SERIAL_CONSOLES = "115200;ttyS2"

MACHINE_ESSENTIAL_EXTRA_RDEPENDS:k3 = ""
MACHINE_EXTRA_RDEPENDS:k3 = "kernel-modules"
EXTRA_IMAGEDEPENDS:k3 = "virtual/bootloader ti-kernel-fitimage"

IMAGE_FSTYPES = ""

IMAGE_CLASSES += "dm-verity"

FIT_KERNEL_COMP_ALG = "zstd"
FIT_KERNEL_COMP_ALG_EXTENSION = ".zst"

FIT_PAD_ALG = "pss"
FIT_HASH_ALG = "sha512"
FIT_SIGN_ALG = "rsa4096"

UBOOT_SIGN_KEYDIR = "${SUMMIT_SOM_KEYS_DIR}/carbon"
UBOOT_SIGN_KEYNAME = "dev"

# Do not set these for k3r5
UBOOT_SIGN_ENABLE:k3 = "1"
KERNEL_IMAGETYPE:k3 = "Image"
KERNEL_IMAGETYPES:k3 = "Image"
IMAGE_BOOT_FILES:k3 = "${SPL_BINARYNAME} u-boot.${UBOOT_SUFFIX} tiboot3.bin uboot.env fitImage"

UBOOT_ENV_OFFSET = "3670016"
EMMC_SPL_OFFSET = "524288"
EMMC_BOOT_OFFSET = "2621440"
EMMC_DEVICE = "0"
SD_DEVICE = "1"
```

## conf/machine/include/carbon-summitsom.inc
```bitbake
#@TYPE: Machine
#@NAME: Carbon AM6xx
#@SOC: AM62x, AM62Lx, AM67x
#@DESCRIPTION: Machine configuration for Carbon AM6xx
#@MAINTAINER: Boris Krasnovskiy <Boris.Krasnovskiy@ezurio.com>

MACHINEOVERRIDES =. "summitsom:"

# for better sstate cache reuse
DEFAULTTUNE:k3 = "armv8a-crc-crypto"

require conf/machine/include/u-boot-summit.inc
include ${@bb.utils.contains('BBFILE_COLLECTIONS', 'summit-radio', 'conf/machine/include/radio-stack.inc', '', d)}

MACHINE_FEATURES = "usbgadget usbhost alsa rtc optee screen wifi bluetooth camera"

TI_PREFERRED_BSP = "ti-6_12"

SWUPDATE_IMAGES = "${SPL_BINARYNAME} u-boot.${UBOOT_SUFFIX} tiboot3.bin uboot.env ${KERNEL_IMAGETYPE}"

BSP_BOOTLOADER_PROVIDER:bsp-ti-6_12 = "u-boot-ti-summit"
BSP_BOOTLOADER_VERSION:bsp-ti-6_12 = "%"

SERIAL_CONSOLES = "115200;ttyS2"

MACHINE_ESSENTIAL_EXTRA_RDEPENDS:remove = "kernel-image-image kernel-devicetree"
MACHINE_EXTRA_RDEPENDS = "kernel-modules"

IMAGE_FSTYPES = ""

IMAGE_CLASSES += "dm-verity"

FIT_KERNEL_COMP_ALG = "zstd"
FIT_KERNEL_COMP_ALG_EXTENSION = ".zst"

FIT_PAD_ALG = "pss"
FIT_HASH_ALG = "sha512"
FIT_SIGN_ALG = "rsa4096"

UBOOT_SIGN_KEYDIR = "${SUMMIT_SOM_KEYS_DIR}/carbon"
UBOOT_SIGN_KEYNAME = "dev"

# Do not set these for k3r5
UBOOT_SIGN_ENABLE:k3 = "1"
KERNEL_IMAGETYPE:k3 = "fitImage"
KERNEL_IMAGETYPES:k3 = "fitImage"
IMAGE_BOOT_FILES:k3 = "${SPL_BINARYNAME} u-boot.${UBOOT_SUFFIX} tiboot3.bin uboot.env ${KERNEL_IMAGETYPE}"

UBOOT_ENV_OFFSET = "4128768"
EMMC_DEVICE = "0"
SD_DEVICE = "1"
```

## conf/machine/include/imx8mm-nitrogen.inc
```bitbake
#@TYPE: Machine
#@NAME: Nitrogen i.MX8M Mini
#@SOC: i.MX8
#@DESCRIPTION: Machine configuration for Nitrogen i.MX8M Mini
#@MAINTAINER: Boris Krasnovskiy <Boris.Krasnovskiy@ezurio.com>

MACHINEOVERRIDES =. "mx8mm:summitsom:"

require conf/machine/include/imx-base.inc
require conf/machine/include/arm/armv8a/tune-cortexa53.inc

require conf/machine/include/u-boot-summit.inc
include ${@bb.utils.contains('BBFILE_COLLECTIONS', 'summit-radio', 'conf/machine/include/radio-stack.inc', '', d)}

DEFAULTTUNE:mx8m-generic-bsp = "armv8a-crc-crypto"

MACHINE_FEATURES += "pci usbhost alsa rtc optee wifi bluetooth camera"

SOC_DEFAULT_IMAGE_FSTYPES = ""

IMAGE_BOOT_FILES = "uboot.env ${KERNEL_IMAGETYPE}"
SWUPDATE_IMAGES = "flash.bin uboot.env ${KERNEL_IMAGETYPE}"

IMX_DEFAULT_BOOTLOADER:mx8m-generic-bsp = "u-boot-imx-summit"
IMX_DEFAULT_UBOOTTOOLS:imx-generic-bsp = "u-boot-summit-tools"

DDR_FIRMWARE_NAME = " \
    lpddr4_pmu_train_1d_dmem.bin \
    lpddr4_pmu_train_1d_imem.bin \
    lpddr4_pmu_train_2d_dmem.bin \
    lpddr4_pmu_train_2d_imem.bin \
"

SPL_BINARY = "spl/u-boot-spl.bin"

ATF_PLATFORM = "imx8mm"

SERIAL_CONSOLES = "115200;ttymxc1"

LOADADDR = ""
UBOOT_SUFFIX = "img"
UBOOT_BINARY = "flash.bin"
UBOOT_MAKE_TARGET = "all"
IMX_BOOT_SEEK = "33"

OPTEE_BIN_EXT = "8mm"
TEE_LOAD_ADDR = "0xbe000000"

MACHINE_EXTRA_RDEPENDS += "${MACHINE_FIRMWARE} kernel-modules"

IMX_DEFAULT_BSP = "nxp"

MACHINE_EXTRA_RRECOMMENDS:remove = "imx-m4-demos"

KERNEL_CLASSES  = "kernel-fitimage"
KERNEL_IMAGETYPES = "fitImage"

KERNEL_IMAGETYPE = "fitImage"
KERNEL_IMAGETYPE:mx8-generic-bsp = "fitImage"
IMAGE_CLASSES += "dm-verity"

UBOOT_DTB_LOADADDRESS = "0x43000000"
UBOOT_ENTRYPOINT:mx8m-generic-bsp = "0x40400000"

FIT_KERNEL_COMP_ALG = "zstd"
FIT_KERNEL_COMP_ALG_EXTENSION = ".zst"

FIT_PAD_ALG = "pss"
FIT_HASH_ALG = "sha256"
FIT_SIGN_ALG = "rsa2048"

CUSTOM_KEYS_DIR ?= ""
UBOOT_SIGN_KEYDIR = "${@oe.utils.conditional('CUSTOM_KEYS_DIR', '', '${SUMMIT_SOM_KEYS_DIR}/summitsom', '${CUSTOM_KEYS_DIR}', d)}"
UBOOT_SIGN_KEYNAME = "dev"
UBOOT_SIGN_ENABLE = "1"

EMMC_BOOT_OFFSET = "33K"
EMMC_DEVICE = "0"
SD_DEVICE = "1"
```

## conf/machine/include/k3r5-carbon.inc
```bitbake
#@TYPE: Machine
#@NAME: Carbon AM6xx
#@SOC: AM62x, AM67x
#@DESCRIPTION: Machine configuration for Carbon AM6xx R5
#@MAINTAINER: Boris Krasnovskiy <Boris.Krasnovskiy@ezurio.com>

MACHINEOVERRIDES =. "summitsom:"

require conf/machine/include/u-boot-summit.inc

TI_PREFERRED_BSP = "ti-6_18"

SERIAL_CONSOLES = "115200;ttyS2"

FIT_PAD_ALG = "pss"
FIT_HASH_ALG = "sha512"
FIT_SIGN_ALG = "rsa4096"

UBOOT_SIGN_KEYDIR = "${SUMMIT_SOM_KEYS_DIR}/carbon"
UBOOT_SIGN_KEYNAME = "dev"

UBOOT_ENV_OFFSET = "3670016"
EMMC_SPL_OFFSET = "524288"
EMMC_BOOT_OFFSET = "2621440"
EMMC_DEVICE = "0"
SD_DEVICE = "1"
```
