// SPDX-License-Identifier: (GPL-2.0+ OR MIT)
/*
 * Copyright 2022 Laird Connectivity
 */

/dts-v1/;

#include "imx8mp-summitsom.dtsi"
#include "imx8mp-summitsom-pcie-uart.dtsi"
#include "imx8mp-summitsom-dvk.dtsi"
#include "imx8mp-summitsom-media-dvk.dtsi"
#include "imx8mp-summitsom-gpu.dtsi"
#include "imx8mp-summitsom-mipi-bridge-dvk.dtsi"
#include "imx8mp-summitsom-hdmi-dvk.dtsi"
#include "imx8mp-summitsom-lvds-bridge-dvk.dtsi"
#include "imx8mp-summitsom-m7-rpmsg.dtsi"
