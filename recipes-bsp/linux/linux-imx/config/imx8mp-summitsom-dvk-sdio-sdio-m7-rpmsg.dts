// SPDX-License-Identifier: LicenseRef-Ezurio-Clause
/*
 * Copyright 2022 Ezurio
 */

/dts-v1/;

#include "imx8mp-summitsom.dtsi"
#include "imx8mp-summitsom-sdio-sdio.dtsi"
#include "imx8mp-summitsom-dvk.dtsi"
#include "imx8mp-summitsom-media-dvk.dtsi"
#include "imx8mp-summitsom-gpu.dtsi"
#include "imx8mp-summitsom-mipi-bridge-dvk.dtsi"
#include "imx8mp-summitsom-hdmi-dvk.dtsi"
#include "imx8mp-summitsom-lvds-bridge-dvk.dtsi"
#include "imx8mp-summitsom-m7-rpmsg.dtsi"
